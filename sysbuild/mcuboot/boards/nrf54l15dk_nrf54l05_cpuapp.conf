## sysbuild/mcuboot/boards/nrf54l15dk_nrf54l05_cpuapp.conf
```kconfig
# Copyright (c) 2024 Nordic Semiconductor ASA
#
# SPDX-License-Identifier: Apache-2.0
#

CONFIG_BOOT_MAX_IMG_SECTORS=381

# Ensure that the SPI NOR driver is disabled by default
CONFIG_SPI_NOR=n

# TODO: below are not yet supported and need fixing
CONFIG_FPROTECT=n

CONFIG_BOOT_WATCHDOG_FEED=n

# Currently, without tickless kernel, the SYSCOUNTER value after the software
# reset is not set properly and due to that the first system interrupt is not called
# in the proper time - the SYSCOUNTER value is set to the value from before
# reset + 1. Hence, the reboot time increases more and more.
# To avoid it enable tickles kernel for mcuboot.
CONFIG_TICKLESS_KERNEL=y

# Low Power mode
CONFIG_POWEROFF=y

#speed up flash operation
CONFIG_NRF_RRAM_WRITE_BUFFER_SIZE=32
```
